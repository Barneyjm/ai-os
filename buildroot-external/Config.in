## buildroot-external/Config.in
```kconfig
menu "AI-OS Packages"

config BR2_PACKAGE_SYSTEM_AGENT
    bool "system-agent"
    select BR2_PACKAGE_PYTHON3
    select BR2_PACKAGE_PYTHON_AIOHTTP
    help
      The core AI system agent.

config BR2_PACKAGE_AI_SHELL
    bool "ai-shell"
    select BR2_PACKAGE_PYTHON3
    select BR2_PACKAGE_PYTHON_PROMPT_TOOLKIT
    select BR2_PACKAGE_PYTHON_RICH
    help
      The conversational terminal interface.

endmenu
```

## buildroot-external/configs/meerkatos_x86_64_defconfig
```kconfig
BR2_x86_64=y
BR2_TOOLCHAIN_BUILDROOT_GLIBC=y
BR2_LINUX_KERNEL=y
BR2_LINUX_KERNEL_USE_DEFCONFIG=y
BR2_LINUX_KERNEL_DEFCONFIG="x86_64"
BR2_INIT_RUNIT=y
BR2_TARGET_ROOTFS_EXT2=y
BR2_TARGET_ROOTFS_EXT2_4=y
BR2_TARGET_ROOTFS_EXT2_SIZE="2G"
BR2_PACKAGE_BUSYBOX=y
BR2_PACKAGE_PYTHON3=y
BR2_PACKAGE_PYTHON_AIOHTTP=y
BR2_PACKAGE_PYTHON_PROMPT_TOOLKIT=y
BR2_PACKAGE_PYTHON_RICH=y
```
